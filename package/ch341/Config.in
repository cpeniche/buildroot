## package/ch341/Config.in
```kconfig
config BR2_PACKAGE_CH341
	bool "ch341"
	depends on BR2_LINUX_KERNEL
	help
	  A standalone driver for the ch341 USB to serial adapter.
	  This is needed only for Linux kernels before 3.12.
	  

comment "ch341 needs a Linux kernel to be built"
	depends on !BR2_LINUX_KERNEL
```

## package/shadow/Config.in
```kconfig
config BR2_PACKAGE_SHADOW
	bool "shadow"	
	help
	  The Shadow package contains programs for handling passwords in a secure way.

	  https://shadow-maint.github.io/shadow/
```
